## boards/shields/locust/Kconfig.shield
```kconfig
config SHIELD_LOCUST_LEFT
    def_bool $(shields_list_contains, locust_left)
    
config SHIELD_LOCUST_RIGHT
    def_bool $(shields_list_contains, locust_right)
```

## config/boards/shields/locust/Kconfig.defconfig
```kconfig
if SHIELD_LOCUST_LEFT

config ZMK_KEYBOARD_NAME
    default "Locust"

config ZMK_SPLIT_ROLE_CENTRAL
    default y

endif

if SHIELD_LOCUST_LEFT || SHIELD_LOCUST_RIGHT

config ZMK_SPLIT
    default y

endif
```
